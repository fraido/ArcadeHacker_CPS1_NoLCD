// CPS1 Desuicider 1.07n by Fraido from arcaderaidi.com

// Changes
// Version 1.00:  [Eduardo] Initial code.
// Version 1.07n: [Fraido]  Forked from main repository. No LCD mod.

//  CPS1 C Board interface pins
#define PIN61       2   //Clock #2.   Connect programmer pin 3 (LCD Extra I/O Pin# 2) to CNB pin 61
#define PIN62       3   //Data.       Connect programmer pin 4 (LCD Extra I/O Pin# 3) to CNB pin 62
#define PIN42       5   //Clock #1.   Connect programmer pin 5 (LCD Extra I/O Pin# 11) to CNA pin 19
#define PIN44       4   //Setup.      Connect programmer pin 6 (LCD Extra I/O Pin# 12) to CNA pin 20

// delay amount
int time = 25;

#define CPSB21_ID 0

unsigned char bytes[][18] = {

{ 0x00, 0x08, 0x00, 0xC0, 0x2E, 0xC1, 0x60, 0x54, 0x00, 0x02, 0x02, 0x80, 0x00, 0x00, 0xA0, 0x98, 0x00, 0x40 }, // 00 CPS_B_01
{ 0x08, 0x0A, 0x00, 0x88, 0x24, 0xC1, 0x30, 0x50, 0x00, 0x00, 0x02, 0xA0, 0x00, 0x00, 0x00, 0xB0, 0x00, 0x40 }, // 01 CPS_B_02
{ 0x0C, 0x12, 0x40, 0x98, 0x28, 0xC1, 0x50, 0x58, 0x00, 0x00, 0x02, 0xE0, 0x00, 0x00, 0x00, 0xC0, 0x01, 0x40 }, // 02 CPS_B_03
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{ 0x00, 0x0C, 0x00, 0xB0, 0x2A, 0x81, 0x40, 0x4C, 0x00, 0x00, 0x02, 0x40, 0x00, 0x00, 0x00, 0x88, 0x01, 0x00 }  // 26 CPS_B_21_QS1

};

char* CPSB21_List[] = 
  { 
  };
  
unsigned char mask = 1; // Bit 
unsigned char bits[8];
int c = -1;

void setup() {
  Serial.begin(9600);

  pinMode(PIN42, OUTPUT); pinMode(PIN44, OUTPUT);
  pinMode(PIN61, OUTPUT); pinMode(PIN62, OUTPUT); 

  digitalWrite(PIN42, LOW);
  digitalWrite(PIN44, LOW);

  DisplayIntro();
}

void DisplayIntro()
{
  Serial.println("CPS1 Desuicide By ArcadeHacker Version 1.07n");
  Serial.println("NoLCD Mod By Fraido");
}

void PIN42CLK()
{
    digitalWrite(PIN42, HIGH); delay(time);
    digitalWrite(PIN42, LOW); delay(time);
}

void PIN61CLK()
{
    digitalWrite(PIN61, HIGH); delay(time);
    digitalWrite(PIN61, LOW); delay(time);
}

void program_unlock()
{
    digitalWrite(PIN44, HIGH);
    delay(time);
    delay(time);
    delay(time);
    PIN42CLK();
    PIN42CLK();
    PIN42CLK();
    PIN42CLK();  
 
    digitalWrite(PIN62, HIGH);
    PIN61CLK();
    digitalWrite(PIN62, LOW);
    PIN61CLK();
    digitalWrite(PIN62, HIGH);
    PIN61CLK();
    digitalWrite(PIN62, LOW);
    PIN61CLK();
    digitalWrite(PIN62, HIGH);
    PIN61CLK();
    PIN61CLK();
    
    PIN61CLK();
    PIN61CLK();
    PIN61CLK();
    PIN61CLK();
    PIN61CLK();
    PIN61CLK();
    PIN61CLK();
    PIN61CLK();
    PIN61CLK();
    PIN61CLK();
    PIN61CLK();
    PIN61CLK();
    
   
} 

void ProgramCPS1(int prg) {
   int i;
   int test;

   Serial.println("Waiting 5 Secs...");
   delay(5000);
   Serial.println("Unlocking .......");                  
      
   program_unlock();      
                
   Serial.println("Programming .....");
   Serial.print  ("CPS-B-21 Keys ... ");    
                               
   for(i=0; i<18; i++) {
      Serial.print(bytes[prg][i], HEX);
      Serial.print(" ");  
      for (int b = 7; b > -1; b--) {  
        bits[b] = (bytes[prg][i] & (mask << b)) != 0;
//      printf("%d",bits[b]);
       
        if (bits[b] == 1) {
          digitalWrite(PIN62, HIGH);}
        else { 
          digitalWrite(PIN62, LOW);}                  
          PIN61CLK();  
        }
   }
   Serial.println("\nDone!");
   Serial.println("Disconnect and test pcb.");                         

   pinMode(PIN42, INPUT); pinMode(PIN44, INPUT);
   pinMode(PIN61, INPUT); pinMode(PIN62, INPUT); 
}
             

void loop() {

  ProgramCPS1(CPSB21_ID); 
  while(1);               

}
